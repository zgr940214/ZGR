## conf/bblayers.conf
```bitbake
POKY_BBLAYERS_CONF_VERSION = "2"
BBPATH = "${TOPDIR}"
BBFILES ?= ""
BBLAYERS = " \
  ${TOPDIR}/../sources/poky/meta \
  ${TOPDIR}/../sources/poky/meta-poky \
  ${TOPDIR}/../sources/poky/meta-yocto-bsp \
  ${TOPDIR}/../sources/meta-raspberrypi \
  ${TOPDIR}/../meta-rpi4-debug \
"
```

## meta-rpi4-debug/conf/layer.conf
```bitbake
BBPATH .= ":${LAYERDIR}"
BBFILES += "${LAYERDIR}/recipes-*/*/*.bb ${LAYERDIR}/recipes-*/*/*.bbappend"
BBFILE_COLLECTIONS += "rpi4debug"
BBFILE_PATTERN_rpi4debug = "^${LAYERDIR}/"
BBFILE_PRIORITY_rpi4debug = "10"
LAYERDEPENDS_rpi4debug = "core raspberrypi"
LAYERSERIES_COMPAT_rpi4debug = "scarthgap"
```
